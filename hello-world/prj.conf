## CMakeLists.txt
```
# SPDX-License-Identifier: Apache-2.0

cmake_minimum_required(VERSION 3.20.0)

set(BOARD "nucleo_wb55rg")

find_package(Zephyr REQUIRED HINTS $ENV{ZEPHYR_BASE})
project(hello_world)

target_sources(app PRIVATE src/main.c)
```

## west.yml
```
manifest:
  version: 0.8

  self:
    path: hello-world

  remotes:
    - name: zephyrproject-rtos
      url-base: https://github.com/zephyrproject-rtos
      
  projects:
    - name: zephyr
      remote: zephyrproject-rtos
      revision: v3.5.0
#     explicitly add Zephyr-specific West extensions (build, flash, debug)
      west-commands: scripts/west-commands.yml
      import: true
#       import:
#         name-allowlist:
#           - cmsis
#           - hal_nordic 
```

## prj.conf
```kconfig
# Print a banner on the UART on startup.
CONFIG_BOOT_BANNER=y
# CONFIG_LOG_MODE_MINIMAL=y # former CONFIG_MODE_MINIMAL

# Enable console and printk()
# CONFIG_PRINTK=y
CONFIG_STDOUT_CONSOLE=y

# Enable Zephyr application to be booted by MCUboot
CONFIG_BOOTLOADER_MCUBOOT=y

# Use the default MCUBoot PEM key file (BOOT_SIGNATURE_KEY_FILE)
CONFIG_MCUBOOT_SIGNATURE_KEY_FILE="bootloader/mcuboot/root-rsa-2048.pem"
# CONFIG_MCUBOOT_SIGNATURE_KEY_FILE="bootloader/mcuboot/samples/zephyr/bad-keys/bad-rsa-2048.pem"
```

## src/main.c
```c
/*
 * Copyright (c) 2012-2014 Wind River Systems, Inc.
 *
 * SPDX-License-Identifier: Apache-2.0
 */

// #include <stdio.h>
#include <zephyr/logging/log.h>

LOG_MODULE_REGISTER(main, LOG_LEVEL_DBG);
int main(void)
{
	LOG_INF("VERSION 0 - Hello World! %s", CONFIG_BOARD_TARGET);
	return 0;
}
```
