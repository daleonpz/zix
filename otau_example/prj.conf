## CMakeLists.txt
```
# Copyright 2025 Daniel Paredes (daleonpz)
# 
# Licensed under the Apache License, Version 2.0 (the "License");
# you may not use this file except in compliance with the License.
# You may obtain a copy of the License at
# 
#     http://www.apache.org/licenses/LICENSE-2.0
# 
# Unless required by applicable law or agreed to in writing, software
# distributed under the License is distributed on an "AS IS" BASIS,
# WITHOUT WARRANTIES OR CONDITIONS OF ANY KIND, either express or implied.
# See the License for the specific language governing permissions and
# limitations under the License.

cmake_minimum_required(VERSION 3.20.0)
# set(BOARD "nucleo_wb55rg")
find_package(Zephyr REQUIRED HINTS $ENV{ZEPHYR_BASE})
project(otau-example)

# this come from sysbuild
message(STATUS "Board: ${BOARD}")

zephyr_get(VERSION_MAJOR SYSBUILD GLOBAL)
zephyr_get(VERSION_MINOR SYSBUILD GLOBAL)
zephyr_get(VERSION_PATCH SYSBUILD GLOBAL)

if(NOT DEFINED VERSION_MAJOR)
    set(VERSION_MAJOR 0)
else()
    set(VERSION_MAJOR ${VERSION_MAJOR})
endif()
if(NOT DEFINED VERSION_MINOR)
    set(VERSION_MINOR 1)
else()
    set(VERSION_MINOR ${VERSION_MINOR})
endif()
if(NOT DEFINED VERSION_PATCH)
    set(VERSION_PATCH 0)
else()
    set(VERSION_PATCH ${VERSION_PATCH})
endif()

message(STATUS "Version: ${VERSION_MAJOR}.${VERSION_MINOR}.${VERSION_PATCH}")
# Set the version string
set(VERSION_STRING "${VERSION_MAJOR}.${VERSION_MINOR}.${VERSION_PATCH}" CACHE STRING "Version string" FORCE)
set(VERSION_NUMBER "${VERSION_MAJOR}${VERSION_MINOR}${VERSION_PATCH}" CACHE STRING "Version number" FORCE)

# Pass the version string to the preprocessor
add_compile_definitions(-DVERSION_STRING="${VERSION_STRING}")
add_compile_definitions(-DVERSION_NUMBER="${VERSION_NUMBER}")

target_sources(app PRIVATE src/main.c)
```

## sysbuild.conf
```
# Sysbuild configuration file.
#
# # Enable MCUboot per default for this sample.
SB_CONFIG_BOOTLOADER_MCUBOOT=y
SB_CONFIG_BOOT_SIGNATURE_KEY_FILE="/home/dnl/Documents/git/nix_zephyr/bootloader/mcuboot/root-rsa-2048.pem"
# SB_CONFIG_BOOT_SIGNATURE_KEY_FILE="/home/dnl/Documents/git/nix_zephyr/bootloader/mcuboot/samples/zephyr/bad-keys/bad-rsa-2048.pem"
```

## west.yml
```
manifest:
  version: 0.8

  self:
    path: otau-example

  remotes:
    - name: zephyrproject-rtos
      url-base: https://github.com/zephyrproject-rtos
      
  projects:
    - name: zephyr
      remote: zephyrproject-rtos
      revision: v3.5.0
      description: Zephyr RTOS
#     explicitly add Zephyr-specific West extensions (build, flash, debug)
      west-commands: scripts/west-commands.yml
      import: true
#       import:
#         name-allowlist:
#           - cmsis
#           - hal_nordic 
```

## prj.conf
```kconfig
CONFIG_GPIO=y

# Enable logging
CONFIG_LOG=y
## Enabel dbg with color, not compatible with CONFIG_LOG_MODE_MINIMAL
CONFIG_LOG_MAX_LEVEL=4
CONFIG_LOG_BACKEND_SHOW_COLOR=y
CONFIG_LOG_DBG_COLOR_BLUE=y

# Flash related
# DFU image manager, enables support to manage DFU images
CONFIG_IMG_MANAGER=y
CONFIG_STREAM_FLASH=y # Required for DFU

CONFIG_BOOTLOADER_MCUBOOT=y # Enable mcuboot bootloader

# Info from https://docs.nordicsemi.com/bundle/ncs-latest/page/nrf/applications/nrf_desktop/doc/dfu_mcumgr.html
CONFIG_MCUMGR=y # Enable mcumgr
CONFIG_MCUMGR_GRP_OS=y # Required for DFU

# MCUmgr dependencies
CONFIG_NET_BUF=y
CONFIG_ZCBOR=y
CONFIG_CRC=y
CONFIG_FLASH_MAP=y
CONFIG_FLASH=y

CONFIG_MCUMGR_TRANSPORT_BT=y # Enable the Bluetooth mcumgr transport (unauthenticated).
CONFIG_MCUMGR_GRP_IMG=y # Enable the image management handlers, Required for DFU
# CONFIG_MCUMGR_GRP_ENUM_LOG_LEVEL_DBG=y
# CONFIG_FLASH_LOG_LEVEL_DBG=y

# CONFIG_MCUMGR_TRANSPORT_LOG_LEVEL_DBG=y
CONFIG_MCUMGR_TRANSPORT_BT_CONN_PARAM_CONTROL_TIMEOUT=1000
CONFIG_MCUMGR_TRANSPORT_BT_CONN_PARAM_CONTROL_MAX_INT=50
CONFIG_MCUMGR_TRANSPORT_BT_CONN_PARAM_CONTROL_MIN_INT=24
# CONFIG_MCUMGR_TRANSPORT_BT_CONN_PARAM_CONTROL_LATENCY=50

# Some command handlers require a large stack.
CONFIG_SYSTEM_WORKQUEUE_STACK_SIZE=2304
CONFIG_MAIN_STACK_SIZE=2048

# Enable Bluetooth
CONFIG_BT=y
CONFIG_BT_PERIPHERAL=y
CONFIG_BT_AUTO_PHY_UPDATE=n
CONFIG_BT_DEVICE_NAME="My Device"
CONFIG_BT_DEVICE_APPEARANCE=0 
# More info about appearance: https://www.bluetooth.com/wp-content/uploads/Files/Specification/Assigned_Numbers.html

# Security
CONFIG_BT_SMP=y # Enable Bluetooth Secure Connections (Bonding), this is not working with FOTA
CONFIG_BT_SETTINGS=y # BLE will take care of storing (and restoring) the Bluetooth state (e.g. pairing keys) and configuration persistently in flash
CONFIG_SETTINGS=y
CONFIG_BT_SIGNING=y
CONFIG_BT_KEYS_OVERWRITE_OLDEST=y
CONFIG_BT_BONDABLE=y
CONFIG_BT_BONDING_REQUIRED=y
CONFIG_FCB=y

CONFIG_MCUMGR_TRANSPORT_BT_PERM_RW_AUTHEN=y ## this one is the default
# CONFIG_MCUMGR_LOG_LEVEL_DBG=y

# CONFIG_BT_HOST_CRYPTO=y
# CONFIG_BT_SMP_ENFORCE_MITM=y
# CONFIG_BT_GATT_DYNAMIC_DB=y
# CONFIG_MCUMGR_TRANSPORT_BT_DYNAMIC_SVC_REGISTRATION=y

# # CONFIG_BT_DIS=y
# # CONFIG_BT_ATT_PREPARE_COUNT=1
# # CONFIG_BT_PRIVACY=y

# Allow for large Bluetooth data packets.
CONFIG_BT_L2CAP_TX_MTU=498
CONFIG_BT_BUF_ACL_TX_SIZE=502
CONFIG_BT_BUF_ACL_RX_SIZE=502
CONFIG_BT_CTLR_DATA_LENGTH_MAX=251

# Enable the mcumgr Packet Reassembly feature over Bluetooth and its configuration dependencies.
# MCUmgr buffer size is optimized to fit one SMP packet divided into five Bluetooth Write Commands,
# transmitted with the maximum possible MTU value: 498 bytes.
# This configs speed up FOTA
CONFIG_MCUMGR_TRANSPORT_BT_CONN_PARAM_CONTROL=y
CONFIG_MCUMGR_TRANSPORT_BT_REASSEMBLY=y
CONFIG_MCUMGR_TRANSPORT_NETBUF_SIZE=2475

CONFIG_MCUMGR_GRP_OS_MCUMGR_PARAMS=y ##  No clear documentation on this, seems required for Android FOTA
CONFIG_MCUMGR_TRANSPORT_WORKQUEUE_STACK_SIZE=4608

# Enable the storage erase command.
CONFIG_MCUMGR_GRP_ZBASIC=y
CONFIG_MCUMGR_GRP_ZBASIC_STORAGE_ERASE=y

# Disable Bluetooth ping support
CONFIG_BT_CTLR_LE_PING=n
```

## overlay-bt.conf
```kconfig
CONFIG_BT=y
CONFIG_BT_PERIPHERAL=y
CONFIG_BT_AUTO_PHY_UPDATE=n

# Allow for large Bluetooth data packets.
CONFIG_BT_L2CAP_TX_MTU=498
CONFIG_BT_BUF_ACL_RX_SIZE=502
CONFIG_BT_BUF_ACL_TX_SIZE=502
CONFIG_BT_CTLR_DATA_LENGTH_MAX=251

# Enable the Bluetooth mcumgr transport (unauthenticated).
CONFIG_MCUMGR_TRANSPORT_BT=y
CONFIG_MCUMGR_TRANSPORT_BT_CONN_PARAM_CONTROL=y

# Enable the Shell mcumgr transport.
CONFIG_BASE64=y
CONFIG_CRC=y
CONFIG_SHELL=y
CONFIG_SHELL_BACKEND_SERIAL=y
CONFIG_MCUMGR_TRANSPORT_SHELL=y

# Enable the mcumgr Packet Reassembly feature over Bluetooth and its configuration dependencies.
# MCUmgr buffer size is optimized to fit one SMP packet divided into five Bluetooth Write Commands,
# transmitted with the maximum possible MTU value: 498 bytes.
CONFIG_MCUMGR_TRANSPORT_BT_REASSEMBLY=y
CONFIG_MCUMGR_TRANSPORT_NETBUF_SIZE=2475
CONFIG_MCUMGR_GRP_OS_MCUMGR_PARAMS=y
CONFIG_MCUMGR_TRANSPORT_WORKQUEUE_STACK_SIZE=4608

# Enable the LittleFS file system.
CONFIG_FILE_SYSTEM=y
CONFIG_FILE_SYSTEM_LITTLEFS=y

# Enable file system commands
CONFIG_MCUMGR_GRP_FS=y

# Enable the storage erase command.
CONFIG_MCUMGR_GRP_ZBASIC=y
CONFIG_MCUMGR_GRP_ZBASIC_STORAGE_ERASE=y

# Disable Bluetooth ping support
CONFIG_BT_CTLR_LE_PING=n

# Disable shell commands that are not needed
CONFIG_CLOCK_CONTROL_NRF_SHELL=n
CONFIG_DEVICE_SHELL=n
CONFIG_DEVMEM_SHELL=n
CONFIG_FLASH_SHELL=n
```

## src/main.c
```c
/*
 * Copyright (c) 2024 Circuit Dojo
 *
 * SPDX-License-Identifier: Apache-2.0
 */

/*
 * Copyright (c) 2016 Intel Corporation
 *
 * SPDX-License-Identifier: Apache-2.0
 */

#include <zephyr/kernel.h>
#include <zephyr/drivers/gpio.h>
#include <zephyr/settings/settings.h>
#include <zephyr/bluetooth/bluetooth.h>
#include <zephyr/bluetooth/conn.h>
// #include <zephyr/bluetooth/uuid.h>
#include <zephyr/bluetooth/gatt.h>
#include <zephyr/bluetooth/hci.h>
#include <zephyr/mgmt/mcumgr/transport/smp_bt.h>

#define LOG_LEVEL LOG_LEVEL_DBG
#include <zephyr/logging/log.h>
LOG_MODULE_REGISTER(otau_smp_sample);

/* 1000 msec = 1 sec */
#define SLEEP_TIME_MS 1000

/* The devicetree node identifier for the "led0" alias. */
#define LED0_NODE DT_ALIAS(led0)

static void start_adv(void);

/*
 * A build error on this line means your board is unsupported.
 * See the sample documentation for information on how to fix this.
 */
static const struct gpio_dt_spec led = GPIO_DT_SPEC_GET(LED0_NODE, gpios);

/* custom service */
#define BT_UUID_CUSTOM_SERVICE_VAL \
        BT_UUID_128_ENCODE(0x12345678, 0x1234, 0x5678, 0x1234, 0x56789abcdef0)

static const struct bt_uuid_128 primary_service_uuid = BT_UUID_INIT_128(
            BT_UUID_CUSTOM_SERVICE_VAL);

static const struct bt_uuid_128 read_characteristic_uuid = BT_UUID_INIT_128(
            BT_UUID_128_ENCODE(0x12345678, 0x1234, 0x5678, 0x1234, 0x56789abcdef1));

static const struct bt_uuid_128 write_characteristic_uuid = BT_UUID_INIT_128(
            BT_UUID_128_ENCODE(0x12345678, 0x1234, 0x5678, 0x1234, 0x56789abcdef2));

static int signed_value;
static struct bt_le_adv_param adv_param;
static int bond_count;

static ssize_t read_signed(struct bt_conn *conn, const struct bt_gatt_attr *attr,
        void *buf, uint16_t len, uint16_t offset)
{
    int *value = &signed_value;

    return bt_gatt_attr_read(conn, attr, buf, len, offset, value,
            sizeof(signed_value));
}

static ssize_t write_signed(struct bt_conn *conn, const struct bt_gatt_attr *attr,
        const void *buf, uint16_t len, uint16_t offset,
        uint8_t flags)
{
    int *value = &signed_value;

    if (offset + len > sizeof(signed_value)) {
        return BT_GATT_ERR(BT_ATT_ERR_INVALID_OFFSET);
    }

    memcpy(value + offset, buf, len);

    LOG_DBG("Write signed value: %d", *value);

    return len;
}

/* Vendor Primary Service Declaration */
BT_GATT_SERVICE_DEFINE(primary_service,
        BT_GATT_PRIMARY_SERVICE(&primary_service_uuid),
        BT_GATT_CHARACTERISTIC(&read_characteristic_uuid.uuid,
            BT_GATT_CHRC_READ,
            BT_GATT_PERM_READ_AUTHEN,
            read_signed, NULL, NULL),
        BT_GATT_CHARACTERISTIC(&write_characteristic_uuid.uuid,
            BT_GATT_CHRC_WRITE,
            BT_GATT_PERM_WRITE_AUTHEN,
            NULL, write_signed, NULL),
        );

/* Register advertising data */
static const struct bt_data ad[] = {
    BT_DATA_BYTES(BT_DATA_FLAGS, (BT_LE_AD_GENERAL | BT_LE_AD_NO_BREDR)),
//     BT_DATA_BYTES(BT_DATA_UUID128_ALL, SMP_BT_SVC_UUID_VAL),
    BT_DATA_BYTES(BT_DATA_UUID128_ALL, BT_UUID_CUSTOM_SERVICE_VAL),
};

static const struct bt_data sd[] = {
    BT_DATA(BT_DATA_NAME_COMPLETE, CONFIG_BT_DEVICE_NAME, sizeof(CONFIG_BT_DEVICE_NAME) - 1),
};


/**********************************************
 * Callbacks BLE 
 *********************************************/
static void auth_passkey_display(struct bt_conn *conn, unsigned int passkey)
{
    char addr[BT_ADDR_LE_STR_LEN];

    bt_addr_le_to_str(bt_conn_get_dst(conn), addr, sizeof(addr));

    LOG_DBG("Passkey for %s: %06u", addr, passkey);
}

static void auth_cancel(struct bt_conn *conn)
{
    char addr[BT_ADDR_LE_STR_LEN];

    bt_addr_le_to_str(bt_conn_get_dst(conn), addr, sizeof(addr));

    LOG_DBG("Pairing cancelled: %s", addr);
}

static void pairing_complete(struct bt_conn *conn, bool bonded)
{
    char addr[BT_ADDR_LE_STR_LEN];

    bt_addr_le_to_str(bt_conn_get_dst(conn), addr, sizeof(addr));

    LOG_DBG("Pairing completed: %s, bonded: %d", addr, bonded);
}

static void pairing_failed(struct bt_conn *conn, enum bt_security_err reason)
{
    char addr[BT_ADDR_LE_STR_LEN];

    bt_addr_le_to_str(bt_conn_get_dst(conn), addr, sizeof(addr));

    LOG_DBG("Pairing failed conn: %s, reason %d %s", addr, reason,
            bt_security_err_to_str(reason));
}

static void pairing_confirm(struct bt_conn *conn)
{
    int err = -1;

    err = bt_conn_auth_pairing_confirm(conn);
    if (err) {
        LOG_ERR("Pairing confirm failed (err %d)", err);
        return;
    }

    char addr[BT_ADDR_LE_STR_LEN];
    bt_addr_le_to_str(bt_conn_get_dst(conn), addr, sizeof(addr));
    LOG_DBG("Pairing confirmed: %s", addr);
}

static void security_changed(struct bt_conn *conn, bt_security_t level,
                         enum bt_security_err err)
{
    char addr[BT_ADDR_LE_STR_LEN];
    bt_addr_le_to_str(bt_conn_get_dst(conn), addr, sizeof(addr));

    if (!err) {
        LOG_DBG("Security changed: %s level %u", addr, level);
    } else {
        LOG_DBG("Security failed: %s level %u err %d %s", addr, level, err,
                bt_security_err_to_str(err));
    }
}

static void connected(struct bt_conn *conn, uint8_t err)
{
    if (err) {
        LOG_ERR("Connection failed, err 0x%02x %s", err, bt_hci_err_to_str(err));
    } else {
        LOG_INF("Connected");
    }
}

static void disconnected(struct bt_conn *conn, uint8_t reason)
{
    LOG_INF("Disconnected, reason 0x%02x %s", reason, bt_hci_err_to_str(reason));
    start_adv();
}

static void start_adv(void)
{
    int err;

    err = bt_le_adv_start(BT_LE_ADV_CONN_FAST_1, ad, ARRAY_SIZE(ad), sd, ARRAY_SIZE(sd));
    if (err) {
        LOG_ERR("Advertising failed to start (err %d)", err);
        return;
    }

    LOG_INF("Advertising successfully started");
}


static struct bt_conn_auth_cb conn_auth_callbacks = {
    .passkey_display = auth_passkey_display,
    .cancel = auth_cancel,
    .pairing_confirm = pairing_confirm,
};

static struct bt_conn_auth_info_cb conn_auth_info_callbacks = {
    .pairing_complete = pairing_complete,
    .pairing_failed = pairing_failed
};

BT_CONN_CB_DEFINE(conn_callbacks) = {
    .connected = connected,
    .disconnected = disconnected,
    .security_changed = security_changed,
};


// BT_GATT_SERVICE_DEFINE(smp_service,
//     BT_GATT_PRIMARY_SERVICE(SMP_BT_SVC_UUID),
//     BT_GATT_CHARACTERISTIC(SMP_BT_CHR_UUID,
//                            BT_GATT_CHRC_WRITE | BT_GATT_CHRC_READ,
//                            BT_GATT_PERM_WRITE_AUTHEN | BT_GATT_PERM_READ_AUTHEN,
//                            NULL, NULL, NULL),
// );

int main(void)
{
    int ret;
    int err;

    LOG_DBG("Board: %s", CONFIG_BOARD);
    LOG_DBG(">>> Revision: %s", VERSION_STRING);
    LOG_DBG("Build time: " __DATE__ " " __TIME__ "");

    if (!gpio_is_ready_dt(&led))
    {
        return -ENODEV;
    }

    ret = gpio_pin_configure_dt(&led, GPIO_OUTPUT_ACTIVE);
    if (ret < 0)
    {
        return -ENODEV;
    }
    
    err = bt_conn_auth_cb_register(&conn_auth_callbacks);
    if (err) {
        LOG_DBG("Failed to register authorization callbacks.");
        return 0;
    }

    err = bt_conn_auth_info_cb_register(&conn_auth_info_callbacks);
    if (err) {
        LOG_DBG("Failed to register authorization info callbacks.");
        return 0;
    }

    /* Enable Bluetooth */
    ret = bt_enable(NULL);
    if (ret < 0)
    {
        LOG_ERR("Bluetooth init failed (err %d)", ret);
        return ret;
    }

    /* Initialize settings */
    if (IS_ENABLED(CONFIG_SETTINGS))
    {
        ret = settings_load();
        if (ret < 0)
        {
            LOG_ERR("Settings load failed (err %d)", ret);
            return ret;
        }
    }

    // I could add a button to reset the bond
    err= bt_unpair(BT_ID_DEFAULT,BT_ADDR_LE_ANY);
    if (err) {
        LOG_INF("Cannot delete bond (err: %d)", err);
    } else  {
        LOG_INF("Bond deleted succesfully");
    }

    /* Start advertising */
    start_adv();
    while (1)
    {
        ret = gpio_pin_toggle_dt(&led);
        if (ret < 0)
        {
            return -ENODEV;
        }
        k_msleep(SLEEP_TIME_MS);
    }

    return 0;
}
```
