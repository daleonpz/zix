## CMakeLists.txt
```
# SPDX-License-Identifier: Apache-2.0

cmake_minimum_required(VERSION 3.20.0)
find_package(Zephyr REQUIRED HINTS $ENV{ZEPHYR_BASE})
project(central)

target_sources(app PRIVATE src/main.c)
target_sources(app PRIVATE src/crypto.c)
target_sources(app PRIVATE src/key.c)
# target_sources(app PRIVATE src/ecdsa.c)
target_include_directories(app PRIVATE utils)

zephyr_library_include_directories(${ZEPHYR_BASE}/samples/bluetooth)
```

## prj.conf
```kconfig
CONFIG_BT=y
CONFIG_BT_SMP=y
CONFIG_BT_CENTRAL=y
CONFIG_BT_DEVICE_NAME="Central test cert"

CONFIG_LOG=y
CONFIG_BT_GATT_CLIENT=y

# CONFIG_BT_BUF_ACL_RX_SIZE=255
# CONFIG_BT_BUF_ACL_TX_SIZE=251
# CONFIG_BT_BUF_CMD_TX_SIZE=255
# CONFIG_BT_BUF_EVT_DISCARDABLE_SIZE=255
# 
# CONFIG_BT_L2CAP_TX_MTU=247

## Number of buffers available for ATT prepare write, setting this to 0 disables GATT long/reliable writes.
#zephyr/doc/connectivity/bluetooth/api/audio/bluetooth-le-audio-arch.rst
#Read long Characteristic Value by setting :kconfig:option:`CONFIG_BT_ATT_PREPARE_COUNT` to a non-zero value.
CONFIG_BT_ATT_PREPARE_COUNT=3
# CONFIG_BT_ATT_LOG_LEVEL_DBG=y
CONFIG_LOG_BUFFER_SIZE=2048

CONFIG_LOG_RUNTIME_FILTERING=y
CONFIG_BT_SMP_LOG_LEVEL_DBG=y

####################
## trying to make auth_oob_data_request work
CONFIG_SETTINGS=y # Needed for CONFIG_BT_SETTINGS
CONFIG_BT_SETTINGS=y # BLE will take care of storing (and restoring) the Bluetooth state (e.g. pairing keys) and configuration persistently in flash
CONFIG_BT_SMP_APP_PAIRING_ACCEPT=y  # Accept pairing requests from the application
CONFIG_BT_SMP_SC_PAIR_ONLY=n  # Disables LE legacy pairing, so only Secure Connections pairing is used
CONFIG_BT_BONDABLE=y
# CONFIG_BT_BONDING_REQUIRED=y
CONFIG_FLASH=y
CONFIG_FLASH_PAGE_LAYOUT=y
CONFIG_FLASH_MAP=y
CONFIG_NVS=y # Needed for Bluetooth storage (Non-volatile storage)

# CONFIG_BT_LOG_LEVEL_DBG=y
# CONFIG_BT_PHY_UPDATE=n
# CONFIG_BT_USER_PHY_UPDATE=y
CONFIG_BT_USER_PHY_UPDATE=y
CONFIG_BT_AUTO_PHY_UPDATE=y

# #################


# CONFIG_BT_LOG_LEVEL_DBG=y
# CONFIG_BT_PRIVACY=y
CONFIG_BT_TESTING=y
# CONFIG_BT_OOB_DATA_FIXED=y
CONFIG_BT_USE_DEBUG_KEYS=y

CONFIG_DEBUG_OPTIMIZATIONS=y


#### CRYPTO
CONFIG_MAIN_STACK_SIZE=8192
CONFIG_HEAP_MEM_POOL_SIZE=8192
CONFIG_MBEDTLS_PSA_CRYPTO_C=y

CONFIG_PSA_WANT_ALG_ECDSA=y
# CONFIG_PSA_WANT_KEY_TYPE_ECC_KEY_PAIR_GENERATE=y
CONFIG_PSA_WANT_KEY_TYPE_ECC_KEY_PAIR_IMPORT=y
# CONFIG_PSA_WANT_KEY_TYPE_ECC_KEY_PAIR_EXPORT=y
CONFIG_PSA_WANT_ECC_SECP_R1_256=y
CONFIG_PSA_WANT_ALG_SHA_256=y

# For key generation
# CONFIG_PSA_WANT_GENERATE_RANDOM=y
```

## src/crypto.c
```c
#include <zephyr/kernel.h>
#include <zephyr/sys/printk.h>
#include <zephyr/logging/log.h>
#include <assert.h>

#include "key.h"
#include "crypto.h"
#include "utils.h"

#ifdef CONFIG_BUILD_WITH_TFM
#include <tfm_ns_interface.h>
#endif

/******************************************************************************
 * Defines
 ****************************************************************************/
#define LOG_LEVEL CONFIG_APP_LOG_LEVEL
LOG_MODULE_REGISTER(CRYPTO);

#define CRYPTO_MAX_MESSAGE_SIZE (100)

/******************************************************************************
 * Global Variables
 ****************************************************************************/
static crypto_key_id _dev_keypair_id;
static crypto_key_id _dev_pubkey_id;
static crypto_key_id _root_pubkey_id;

/******************************************************************************
 * Helper functions
 ****************************************************************************/
static int import_key(const uint8_t *key, size_t key_size, crypto_key_id *key_id, int is_public)
{
    psa_key_attributes_t key_attributes = PSA_KEY_ATTRIBUTES_INIT;
    psa_status_t status;

    assert(key != NULL);
    assert(key_id != NULL);
    assert(key_size == CRYPTO_PUBLIC_KEY_SIZE || key_size == CRYPTO_KEYPAIR_SIZE);

    // Configure the key attributes
    if (is_public) {
        psa_set_key_usage_flags(&key_attributes, PSA_KEY_USAGE_VERIFY_HASH);
        psa_set_key_type(&key_attributes, PSA_KEY_TYPE_ECC_PUBLIC_KEY(PSA_ECC_FAMILY_SECP_R1));
    } else {
        psa_set_key_usage_flags(&key_attributes, PSA_KEY_USAGE_SIGN_HASH);
        psa_set_key_type(&key_attributes, PSA_KEY_TYPE_ECC_KEY_PAIR(PSA_ECC_FAMILY_SECP_R1));
    }
    psa_set_key_lifetime(&key_attributes, PSA_KEY_LIFETIME_VOLATILE);
    psa_set_key_algorithm(&key_attributes, PSA_ALG_ECDSA(PSA_ALG_SHA_256));
    psa_set_key_bits(&key_attributes, 256);

    // Import the key into the PSA Crypto subsystem
    status = psa_import_key(&key_attributes, key, key_size, key_id);
    if (status != PSA_SUCCESS) {
        LOG_INF("psa_import_key failed! (Error: %d)", status);
        return -1;
    }

    // Reset key attributes and free any allocated resources.
    psa_reset_key_attributes(&key_attributes);
    return 0;
}

/******************************************************************************
 * Function Implementations
 ******************************************************************************/
/** Initialize the PSA Crypto subsystem.
 */
int crypto_init(void)
{
    psa_status_t status;

    status = psa_crypto_init();
    if (status != PSA_SUCCESS) {
        return -1;
    }
    return 0;
}

/** Clean up the PSA Crypto subsystem by destroying the imported keys.
 */
int crypto_clean(void)
{
    psa_status_t status;

    status = psa_destroy_key(_dev_keypair_id);
    if (status != PSA_SUCCESS) {
        LOG_INF("Destroying device key pair failed! (Error: %d)", status);
        return -1;
    }

    status = psa_destroy_key(_dev_pubkey_id);
    if (status != PSA_SUCCESS) {
        LOG_INF("Destroying device public key failed! (Error: %d)", status);
        return -1;
    }

    status = psa_destroy_key(_root_pubkey_id);
    if (status != PSA_SUCCESS) {
        LOG_INF("Destroying root public key failed! (Error: %d)", status);
        return -1;
    }
    return 0;
}

/** Import the device key pair, device public key, and root public key into the PSA Crypto subsystem.
 */
int crypto_import_keys(void)
{
    int status;

    status = import_key(dev_keypair, sizeof(dev_keypair), &_dev_keypair_id, 0);
    if (status != 0) {
        LOG_INF("Importing device key pair failed!");
        return -1;
    }

    status = import_key(dev_cert.pubkey, sizeof(dev_cert.pubkey), &_dev_pubkey_id, 1);
    if (status != 0) {
        LOG_INF("Importing device public key failed!");
        return -1;
    }

    status = import_key(root_cert.pubkey, sizeof(root_cert.pubkey), &_root_pubkey_id, 1);
    if (status != 0) {
        LOG_INF("Importing root public key failed!");
        return -1;
    }

    status = crypto_verify_cert(&dev_cert, NULL);
    if (status != 0) {
        LOG_INF("Device certificate verification failed during key import!");
        return -1;
    }

    return 0;
}

/** Verify the authenticity of the device certificate using the root public key.
 */
int crypto_verify_cert(const struct crypto_cert *cert, crypto_key_id *cert_pubkey_id)
{
    psa_status_t status;
    size_t len;
    uint8_t header[CRYPTO_CERT_HEADER_SIZE];
    crypto_key_id pubkey_id;

    if (cert == NULL) {
        LOG_INF("Certificate is NULL!");
        return -1;
    }

    len = CRYPTO_CERT_HEADER_SIZE;

    // NRF52840's cryptocell has a limitation where it can only process data up to 63 bytes if data is in flash.
    // To work around this, we copy the certificate header into RAM before calling psa_verify_message.
    memcpy(header, &cert->version, len);
    LOG_INF("Verifying certificate of length %u bytes...", len);
    status = psa_verify_message(_root_pubkey_id, PSA_ALG_ECDSA(PSA_ALG_SHA_256), header, len,
                                cert->signature, sizeof(cert->signature));
    if (status != PSA_SUCCESS) {
        LOG_INF("psa_verify_message failed! (Error: %d)", status);
        return -1;
    }

    LOG_INF("Certificate verification was successful!");

    if (cert_pubkey_id != NULL) {
        //
        // If caller provided a pointer to store the certificate's public key ID, import the public key and return its ID.
        //
        status = import_key(cert->pubkey, sizeof(cert->pubkey), &pubkey_id, 1);
        if (status != 0) {
            LOG_INF("Importing certificate public key failed!");
            return -1;
        }
        *cert_pubkey_id = pubkey_id;
    }

    return 0;
}

/** Sign a message using the device's private key.
 */
int crypto_sign_message(const uint8_t *message, size_t message_len, uint8_t *signature,
                        size_t *signature_len, crypto_key_id signing_key_id)
{
    uint32_t len;
    psa_status_t status;
    uint8_t msg[CRYPTO_MAX_MESSAGE_SIZE];
    crypto_key_id key_id;

    if (message == NULL || signature == NULL || signature_len == NULL) {
        LOG_INF("Invalid input to crypto_sign_message!");
        return -1;
    }

    if (message_len > CRYPTO_MAX_MESSAGE_SIZE) {
        LOG_INF("Message length exceeds maximum allowed size!");
        return -1;
    }

    if (*signature_len != CRYPTO_SIGNATURE_SIZE) {
        LOG_INF("Invalid signature buffer length! (Expected: %u, Actual: %u)",
                CRYPTO_SIGNATURE_SIZE, *signature_len);
        return -1;
    }

    // NRF52840's cryptocell has a limitation where it can only process data up to 63 bytes if data is in flash.
    // To work around this, we copy the certificate header into RAM before calling psa_verify_message.
    memcpy(msg, message, message_len);
    LOG_INF("Signing a message...");
    if (signing_key_id != 0) {
        key_id = signing_key_id;
    } else {
        key_id = _dev_keypair_id;
    }

    // len parameter is used to return the actual size of the generated signature.
    status = psa_sign_message(key_id, PSA_ALG_ECDSA(PSA_ALG_SHA_256), msg, message_len, signature,
                              *signature_len, &len);
    if (status != PSA_SUCCESS) {
        LOG_INF("psa_sign_message failed! (Error: %d)", status);
        return -1;
    }

    // Sanity check, the generated signature length should always
    // be equal to CRYPTO_SIGNATURE_SIZE.
    if (len != CRYPTO_SIGNATURE_SIZE) {
        LOG_INF("Unexpected signature size! (Expected: %u, Actual: %u)", CRYPTO_SIGNATURE_SIZE,
                len);
        return -1;
    }

    LOG_INF("Signing was successful!");
    return 0;
}

/** Verify a message signature using the device's public key.
 */
int crypto_verify_message(const uint8_t *message, size_t message_len, const uint8_t *signature,
                          size_t signature_len)
{
    psa_status_t status;

    if (message == NULL || signature == NULL) {
        LOG_INF("Invalid input to crypto_verify_message!");
        return -1;
    }

    if (message_len > CRYPTO_MAX_MESSAGE_SIZE) {
        LOG_INF("Message length exceeds maximum allowed size!");
        return -1;
    }

    if (signature_len != CRYPTO_SIGNATURE_SIZE) {
        LOG_INF("Invalid signature length! (Expected: %u, Actual: %u)", CRYPTO_SIGNATURE_SIZE,
                signature_len);
        return -1;
    }

    LOG_INF("Verifying signature...");
    status = psa_verify_message(_dev_pubkey_id, PSA_ALG_ECDSA(PSA_ALG_SHA_256), message,
                                message_len, signature, signature_len);
    if (status != PSA_SUCCESS) {
        LOG_INF("psa_verify_message failed! (Error: %d)", status);
        return -1;
    }
    LOG_INF("Signature verification was successful!");
    return 0;
}
```

## src/crypto.h
```c
// Copyright (c) 2026 Daniel Paredes (daleonpz)
// SPDX-License-Identifier: Apache-2.0

#pragma once

#include <stdio.h>
#include <stdint.h>
#include <psa/crypto.h>

/******************************************************************************
 * Defines
 ****************************************************************************/
#define CRYPTO_DEV_ID_SIZE      (16)
#define CRYPTO_SIGNATURE_SIZE   (64)
#define CRYPTO_PUBLIC_KEY_SIZE  (65)
#define CRYPTO_KEYPAIR_SIZE     (32)
//
// Certificate structure:
// - version (1 byte)
// - key type (1 byte)
// - device id (16 bytes)
// - public key (65 bytes for uncompressed ECDSA)
// - signature (64 bytes for ECDSA)
//
#define CRYPTO_CERT_HEADER_SIZE (1 + 1 + CRYPTO_DEV_ID_SIZE + CRYPTO_PUBLIC_KEY_SIZE)
#define CRYPTO_CERT_SIZE        (CRYPTO_CERT_HEADER_SIZE + CRYPTO_SIGNATURE_SIZE)
#define CRYPTO_MAX_MESSAGE_SIZE (100)

typedef psa_key_id_t crypto_key_id;

/******************************************************************************
 * Data Structures
 ****************************************************************************/

/** @brief Structure representing a device certificate.
 *
 *  This structure contains the fields of a device certificate, including:
 *  - version    The version of the certificate format.
 *  - key_type   The type of the public key (e.g., ECDSA).
 *  - device_id  A unique identifier for the device.
 *  - pubkey     The public key associated with the device.
 *  - signature  The signature of the certificate, signed by the root private key.
 */
// TODO: should this be packed and aligned?
struct crypto_cert {
    uint8_t version;
    uint8_t key_type;
    uint8_t device_id[CRYPTO_DEV_ID_SIZE];
    uint8_t pubkey[CRYPTO_PUBLIC_KEY_SIZE];
    uint8_t signature[CRYPTO_SIGNATURE_SIZE];
};
_Static_assert(sizeof(struct crypto_cert) == CRYPTO_CERT_SIZE,
               "Certificate structure size mismatch!");

/** @brief Initialize the cryptographic subsystem.
 *
 *  @return 0 on success, negative error value on failure.
 */
int crypto_init(void);

/** @brief Import the device's key pair and the root public key into the cryptographic subsystem.
 *
 *  @return 0 on success, negative error value on failure.
 */
int crypto_import_keys(void);

/** @brief Sign a message using the device's private key.
 *
 *  @param message         The message to be signed.
 *  @param message_len     The length of the message in bytes.
 *  @param signature       Buffer to hold the generated signature.
 *  @param signature_len   Pointer to a variable that holds the size of the signature buffer.
 *                         On success, it will be updated with the actual size of the generated signature.
 *  @param signing_key_id  Optional:
 *                         The key ID to use for signing.
 *                         If 0, the device's default key pair will be used.
 *
 *  @return 0 on success, negative error value on failure.
 */
int crypto_sign_message(const uint8_t *message, size_t message_len, uint8_t *signature,
                        size_t *signature_len, crypto_key_id signing_key_id);

/** @brief Verify a message signature using the device's public key.
 *
 *  @param message       The original message that was signed.
 *  @param message_len   The length of the message in bytes.
 *  @param signature     The signature to be verified.
 *  @param signature_len The length of the signature in bytes.
 *
 *  @return 0 if the signature is valid, negative error value on failure.
 */
int crypto_verify_message(const uint8_t *message, size_t message_len, const uint8_t *signature,
                          size_t signature_len);

/**  @brief Verify the device's certificate using the root public key.
 *
 *  @param cert              Pointer to the certificate to be verified.
 *  @param cert_pubkey       Optional
 *                           Pointer to a variable to receive the key ID of the certificate's public key.
 *                           If provided, the certificate's public key will be imported
 *                           and its key ID will be stored in this variable.
 *
 *  @return 0 if the certificate is valid, negative error value on failure.
 */
int crypto_verify_cert(const struct crypto_cert *cert, crypto_key_id *cert_pubkey);

/** @brief Clean up the cryptographic subsystem, releasing any allocated resources.
 *
 *  @return 0 on success, negative error value on failure.
 */
int crypto_clean(void);
```

## src/key.c
```c
#include "key.h"

/* ================= ROOT CERT ================= */
/* Certificate 'root_cert' */
// Size: pubkey 65 bytes, signature 64 bytes
const struct crypto_cert root_cert = {
        .version = 1,
        .key_type = 1,
        .device_id = {0x00, 0x00, 0x00, 0x00, 0x00, 0x00, 0x00, 0x00, 0x00, 0x00, 0x00, 0x00, 0x00,
                      0x00, 0x00, 0x00},
        .pubkey = {0x04, 0xB7, 0x80, 0x30, 0xA6, 0x1C, 0xAF, 0x59, 0xD5, 0x38, 0x0A, 0xAD, 0x1D,
                   0xAA, 0x34, 0x4A, 0xBD, 0x2D, 0x7A, 0x38, 0x1E, 0x60, 0xCA, 0xB6, 0xE0, 0x54,
                   0xD1, 0xE2, 0x2D, 0x3B, 0x32, 0xF5, 0x27, 0xB1, 0x7F, 0x4F, 0x22, 0x4A, 0xA0,
                   0xD2, 0x87, 0x46, 0xA4, 0x44, 0xA9, 0x4D, 0xD3, 0x24, 0xEF, 0xA3, 0xBA, 0x71,
                   0x75, 0xF6, 0x03, 0x78, 0x25, 0xA7, 0x7D, 0xA8, 0x02, 0xBE, 0xB9, 0xEF, 0xFC},
        .signature = {0x8B, 0x12, 0x4F, 0xF6, 0x3E, 0xFC, 0x89, 0xE6, 0x66, 0xA1, 0xA8, 0x4F, 0x20,
                      0xE6, 0xF0, 0xE0, 0x0A, 0x02, 0xD8, 0xDE, 0xF1, 0xA1, 0x47, 0x90, 0x7E, 0x5D,
                      0xDF, 0x98, 0xDD, 0xE7, 0x03, 0x18, 0x97, 0x58, 0x71, 0x99, 0xE0, 0xD8, 0xF4,
                      0x75, 0xD2, 0x7B, 0x9F, 0x22, 0xB3, 0xA6, 0xC8, 0x36, 0xC5, 0x07, 0x18, 0x90,
                      0xA1, 0x36, 0x36, 0x96, 0xC5, 0x5A, 0x79, 0xFE, 0x19, 0x0A, 0xC4, 0xB0}};

/* root_keypair (32 bytes) */
const uint8_t root_keypair[] = {
        0xC5, 0x06, 0x12, 0xD1, 0x87, 0x59, 0x30, 0x31, 0x76, 0x5F, 0x0C,
        0xF1, 0x6A, 0x4C, 0x87, 0x57, 0xB3, 0x70, 0xE8, 0xD2, 0x90, 0x46,
        0x10, 0x85, 0xD5, 0xBE, 0x7E, 0x70, 0x2F, 0xD0, 0x1C, 0xC4,
};

/* ================= DEVICE CERT ================= */
/* Certificate 'dev_cert' */
// Size: pubkey 65 bytes, signature 64 bytes
const struct crypto_cert dev_cert = {
        .version = 1,
        .key_type = 1,
        .device_id = {0x00, 0x88, 0xF2, 0x22, 0x3F, 0xE3, 0x18, 0x2A, 0x26, 0x36, 0x92, 0xA9, 0x62,
                      0xFF, 0xC2, 0x05},
        .pubkey = {0x04, 0x78, 0xAB, 0xFF, 0x06, 0x1C, 0x83, 0xF6, 0x2A, 0x89, 0xDC, 0xB5, 0x71,
                   0x40, 0x66, 0xDF, 0x61, 0x3E, 0x5F, 0x8D, 0xC3, 0x16, 0xFD, 0x25, 0x2E, 0x1A,
                   0x6F, 0x53, 0xA1, 0xB6, 0xB0, 0x31, 0x52, 0x97, 0x0D, 0xA6, 0x6C, 0xCF, 0x1B,
                   0x79, 0x4A, 0x56, 0x35, 0x93, 0x1C, 0xDE, 0xC0, 0x42, 0x6B, 0xB7, 0xBB, 0xD4,
                   0x19, 0x0D, 0xE7, 0xC2, 0x21, 0xEE, 0x08, 0x44, 0xA8, 0x5D, 0x16, 0x24, 0x56},
        .signature = {0x8B, 0x75, 0x6B, 0x0A, 0x4A, 0x81, 0x85, 0xDD, 0x73, 0xA1, 0x17, 0xEA, 0x3A,
                      0x3F, 0xE4, 0x6E, 0x0F, 0x5D, 0x40, 0xAE, 0x8D, 0xBF, 0xD6, 0xC9, 0x27, 0x80,
                      0x82, 0x0B, 0x4A, 0xEC, 0x94, 0x80, 0x9D, 0x58, 0x59, 0x18, 0x32, 0x47, 0xC3,
                      0x09, 0xBD, 0x85, 0x8E, 0xE5, 0xDD, 0xCB, 0x8E, 0x4E, 0x52, 0x49, 0x1A, 0x0F,
                      0x37, 0x70, 0x41, 0xED, 0x20, 0x67, 0x63, 0x76, 0x7B, 0xC8, 0x03, 0xEE}};

/* dev_keypair (32 bytes) */
const uint8_t dev_keypair[] = {
        0x9D, 0x74, 0x30, 0x4F, 0x8E, 0x95, 0x60, 0x99, 0x3E, 0x7F, 0x0A,
        0xDD, 0x91, 0xC5, 0x8E, 0xAB, 0xD3, 0xF5, 0x5A, 0x84, 0xD6, 0x4E,
        0x1D, 0x72, 0xF0, 0x16, 0x39, 0x0F, 0x94, 0xD3, 0x0B, 0x7A,
};
```

## src/key.h
```c
#pragma once

#include "crypto.h"

extern const struct crypto_cert root_cert;
extern const uint8_t root_keypair[CRYPTO_KEYPAIR_SIZE];

extern const struct crypto_cert dev_cert;
extern const uint8_t dev_keypair[CRYPTO_KEYPAIR_SIZE];
```
