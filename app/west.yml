## app/west.yml
```yaml
manifest:
  version: 0.8

  self:
    path: app

  remotes:
    - name: zephyrproject-rtos
      url-base: https://github.com/zephyrproject-rtos
      
  projects:
    - name: zephyr
      remote: zephyrproject-rtos
      revision: v3.5.0
#     explicitly add Zephyr-specific West extensions (build, flash, debug)
      west-commands: scripts/west-commands.yml
      import: true
#       import:
#         name-allowlist:
#           - cmsis
#           - hal_nordic 
```

## stwinkt1b_app/boards/steval_stwinkt1b/Kconfig.steval_stwinkt1b
```kconfig
# Copyright (c) 2024 STMicroelectronics
# SPDX-License-Identifier: Apache-2.0

config BOARD_STEVAL_STWINKT1B
	select SOC_STM32U585XX
```

## stwinkt1b_app/boards/steval_stwinkt1b/board.yml
```yaml
board:
  name: steval_stwinkt1b
  full_name: STEVAL STWINKT1B Development kit
  vendor: st
  socs:
   - name: stm32l4r9xx
```

## workspace-m/app/west.yml
```yaml
manifest:
  version: 0.8

  self:
    path: app

  projects:
    - name: zephyr
      revision: v3.4.0
      url: https://github.com/zephyrproject-rtos/zephyr
      path: deps/zephyr
      # explicitly add Zephyr-specific West extensions
      west-commands: scripts/west-commands.yml
```
